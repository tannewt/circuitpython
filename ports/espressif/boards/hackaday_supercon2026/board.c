// This file is part of the CircuitPython project: https://circuitpython.org
//
// SPDX-FileCopyrightText: Copyright (c) 2026 Hackaday
//
// SPDX-License-Identifier: MIT

#include "supervisor/board.h"
#include "board.h"
#include "mpconfigboard.h"

#include "driver/gpio.h"
#include "py/mphal.h"

#include "shared-bindings/epaperdisplay/EPaperDisplay.h"
#include "shared-bindings/itc97/ITC97Bus.h"
#include "shared-bindings/microcontroller/Pin.h"
#include "shared-module/displayio/__init__.h"

// OTP is read over the bidirectional SDA pin before ITC97Bus takes ownership of
// the pins and routes them to hardware SPI. GPIO45 is not connected to the panel.
#define EPD_SCK GPIO_NUM_21
#define EPD_SDA GPIO_NUM_47
#define EPD_CS1 GPIO_NUM_13
#define EPD_CS2 GPIO_NUM_3
#define EPD_DC GPIO_NUM_10
#define EPD_RST GPIO_NUM_11
#define EPD_PWR GPIO_NUM_48
#define EPD_OTP_SIZE (88)

static void epd_otp_write_byte(uint8_t value) {
    for (uint8_t mask = 0x80; mask != 0; mask >>= 1) {
        gpio_set_level(EPD_SDA, (value & mask) != 0);
        mp_hal_delay_us(10);
        gpio_set_level(EPD_SCK, true);
        mp_hal_delay_us(10);
        gpio_set_level(EPD_SCK, false);
    }
}

static uint8_t epd_otp_read_byte(void) {
    uint8_t value = 0;
    for (uint8_t bit = 0; bit < 8; bit++) {
        mp_hal_delay_us(10);
        gpio_set_level(EPD_SCK, true);
        mp_hal_delay_us(10);
        value = (value << 1) | gpio_get_level(EPD_SDA);
        gpio_set_level(EPD_SCK, false);
    }
    return value;
}

static void epd_otp_command(uint8_t command, const uint8_t *data, size_t length) {
    gpio_set_level(EPD_DC, false);
    gpio_set_level(EPD_CS1, false);
    gpio_set_level(EPD_CS2, false);
    epd_otp_write_byte(command);
    gpio_set_level(EPD_CS1, true);
    gpio_set_level(EPD_CS2, true);
    gpio_set_level(EPD_DC, true);
    gpio_set_level(EPD_CS1, false);
    gpio_set_level(EPD_CS2, false);
    for (size_t i = 0; i < length; i++) {
        epd_otp_write_byte(data[i]);
    }
    gpio_set_level(EPD_CS1, true);
    gpio_set_level(EPD_CS2, true);
}

static void epd_otp_read(uint8_t command, uint8_t *otp) {
    // Only the master COG may drive SDA during readback.
    gpio_set_level(EPD_DC, false);
    gpio_set_level(EPD_CS1, false);
    epd_otp_write_byte(command);
    gpio_set_level(EPD_DC, true);
    gpio_set_level(EPD_SDA, true);
    gpio_set_direction(EPD_SDA, GPIO_MODE_INPUT);
    (void)epd_otp_read_byte(); // Dummy byte before the fuse data.
    for (size_t i = 0; i < EPD_OTP_SIZE; i++) {
        otp[i] = epd_otp_read_byte();
    }
    gpio_set_level(EPD_CS1, true);
    gpio_set_level(EPD_SDA, false);
    gpio_set_direction(EPD_SDA, GPIO_MODE_OUTPUT);
}

static void epd_otp_reset(void) {
    // Active-low power enable. Observe the minimum rail-discharge interval
    // between probe attempts, as well as before the first attempt.
    gpio_set_level(EPD_PWR, true);
    gpio_set_level(EPD_RST, true);
    mp_hal_delay_ms(1500);
    gpio_set_level(EPD_PWR, false);
    mp_hal_delay_ms(800);
    mp_hal_delay_ms(50);
    gpio_set_level(EPD_RST, false);
    mp_hal_delay_ms(100);
    gpio_set_level(EPD_RST, true);
    mp_hal_delay_ms(400);
}

static uint8_t epd_detect_variant(void) {
    // No pin objects or heap allocations are needed during early board init.
    gpio_set_level(EPD_PWR, true);
    gpio_set_level(EPD_RST, true);
    gpio_set_level(EPD_CS1, true);
    gpio_set_level(EPD_CS2, true);
    gpio_set_level(EPD_DC, false);
    gpio_set_level(EPD_SCK, false);
    gpio_set_level(EPD_SDA, false);
    const gpio_config_t config = {
        .pin_bit_mask = (1ULL << EPD_PWR) | (1ULL << EPD_RST) |
            (1ULL << EPD_CS1) | (1ULL << EPD_CS2) | (1ULL << EPD_DC) |
            (1ULL << EPD_SCK) | (1ULL << EPD_SDA),
        .mode = GPIO_MODE_OUTPUT,
        .pull_up_en = GPIO_PULLUP_DISABLE,
        .pull_down_en = GPIO_PULLDOWN_DISABLE,
        .intr_type = GPIO_INTR_DISABLE,
    };
    gpio_config(&config);

    uint8_t otp[EPD_OTP_SIZE];
    uint8_t variant = 0;
    epd_otp_reset();
    epd_otp_command(0xA1, (const uint8_t[]) {0x00}, 1);
    epd_otp_command(0xA7, (const uint8_t[]) {0x80}, 1);
    epd_otp_command(0xA3, (const uint8_t[]) {0x00, 0x40}, 2);
    epd_otp_read(0xA8, otp);
    if (otp[0x00] == 0xA5 && otp[0x17] == 0x3B && otp[0x0D] == 0x3B) {
        variant = 84;
    } else {
        epd_otp_reset();
        epd_otp_command(0x70, (const uint8_t[]) {0x71, 0x36}, 2);
        epd_otp_read(0xB9, otp);
        // B1 has a different layout; do not identify it by a header byte.
        if (otp[0x16] == 0x3B && otp[0x0D] == 0x3B && (otp[0x28] & 0x80) != 0) {
            variant = 1;
        }
    }

    // Neither probe enables the booster. Power off without releasing the bus
    // pins; the ITC97Bus constructor will take them over after a successful read.
    gpio_set_level(EPD_DC, false);
    gpio_set_level(EPD_RST, false);
    gpio_set_level(EPD_PWR, true);
    return variant;
}

static const uint8_t display_start_sequence_084[] = {
    0x13, 0x06, 0x00, 0x3B, 0x00, 0x00, 0x9F, 0x02,
    0x90, 0x04, 0x00, 0x3B, 0x00, 0xA9, 0x12, 0x03,
    0x3B, 0x00, 0x14,
};

static const uint8_t display_refresh_sequence_084[] = {
    0x05, 0x81, 0x7D, 0xC8, 0x05, 0x81, 0x00, 0x0A,
    0xC2, 0x01, 0x3F, 0xD8, 0x01, 0x80, 0xD6, 0x01,
    0x00, 0xA7, 0x81, 0x10, 0x64, 0xA7, 0x81, 0x00,
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    0x01, 0x3C,
};

static const uint8_t display_start_sequence_b1[] = {
    0x70, 0x02, 0x71, 0x36, 0x01, 0x01, 0x00, 0x13,
    0x06, 0x00, 0x3B, 0x00, 0x00, 0x9F, 0x02, 0x90,
    0x04, 0x00, 0x3B, 0x00, 0xA9, 0x12, 0x03, 0x3B,
    0x00, 0x14,
};

static const uint8_t display_refresh_sequence_b1[] = {
    0x05, 0x81, 0x7D, 0xC8, 0x05, 0x81, 0x00, 0x0A,
    0xD8, 0x01, 0x80, 0xD6, 0x01, 0x00, 0xA7, 0x81,
    0x10, 0x64, 0xA7, 0x81, 0x00, 0x64, 0x44, 0x01,
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    0x02, 0x09, 0x81, 0xFF, 0x0A, 0x15, 0x01, 0x3C,
};

static const uint8_t display_stop_sequence[] = {
    0x09, 0x81, 0x7F, 0x14, 0x05, 0x01, 0x7D, 0x09,
    0x81, 0x00, 0xC8,
};

void board_init(void) {
    uint8_t variant = epd_detect_variant();
    board_set(MP_QSTR_ITC97_VARIANT, MP_OBJ_NEW_SMALL_INT(variant));
    if (variant == 0) {
        // An absent panel or invalid OTP must not select an unsafe booster setup.
        return;
    }

    itc97_itc97bus_obj_t *bus = &allocate_display_bus_or_raise()->itc97_bus;
    bus->base.type = &itc97_itc97bus_type;

    common_hal_itc97_itc97bus_construct(bus,
        &pin_GPIO21, // EPD_SCK
        &pin_GPIO47, // EPD_MOSI
        &pin_GPIO13, // EPD_CS1
        &pin_GPIO3,  // EPD_CS2
        &pin_GPIO10, // EPD_DC
        &pin_GPIO11, // EPD_RST
        &pin_GPIO48, // EPD_PWR_ENABLE, active low
        4000000, 0, 0);

    epaperdisplay_epaperdisplay_obj_t *display = &allocate_display_or_raise()->epaper_display;
    display->base.type = &epaperdisplay_epaperdisplay_type;

    epaperdisplay_construct_args_t args = EPAPERDISPLAY_CONSTRUCT_ARGS_DEFAULTS;
    args.bus = bus;
    if (variant == 1) {
        args.start_sequence = display_start_sequence_b1;
        args.start_sequence_len = sizeof(display_start_sequence_b1);
        args.refresh_sequence = display_refresh_sequence_b1;
        args.refresh_sequence_len = sizeof(display_refresh_sequence_b1);
    } else {
        args.start_sequence = display_start_sequence_084;
        args.start_sequence_len = sizeof(display_start_sequence_084);
        args.refresh_sequence = display_refresh_sequence_084;
        args.refresh_sequence_len = sizeof(display_refresh_sequence_084);
    }
    args.stop_sequence = display_stop_sequence;
    args.stop_sequence_len = sizeof(display_stop_sequence);
    // ITC97Bus waits for ready only after the complete booster ramp, not
    // between its individual writes (which would prevent it becoming ready).
    args.refresh_sequence_wait_for_busy = false;
    args.width = 960;
    args.height = 672;
    args.ram_width = 960;
    args.ram_height = 672;
    args.write_black_ram_command = 0x10;
    args.write_color_ram_command = 0x11;
    args.highlight_color = 0xFF0000;
    args.black_bits_inverted = true;
    args.color_bits_inverted = false;
    args.busy_pin = &pin_GPIO12;
    args.busy_pin2 = &pin_GPIO8;
    args.busy_state = false;
    // Allow explicit refreshes at any time while bringing up the panel.
    args.seconds_per_frame = 0.0;
    common_hal_epaperdisplay_epaperdisplay_construct(display, &args);
    // EPaperDisplay defaults to MSB-first pixels (084). B1 expects the pixels
    // within each byte in the opposite order, matching epd.py's reverse_byte().
    // Change framebuffer packing, not SPI bit order: commands stay MSB-first.
    display->core.colorspace.reverse_pixels_in_byte = variant != 1;
    // iTC97 encodes white=(0,0), black=(1,0), red=(0,1). Never set both
    // RAM-plane bits for a red pixel: that selects an unused waveform table.
    display->core.colorspace.tricolor_highlight_is_white = true;
    board_set(MP_QSTR_DISPLAY, MP_OBJ_FROM_PTR(display));
}

void board_deinit(void) {
    common_hal_displayio_release_displays();
}

// Use the MP_WEAK supervisor/shared/board.c versions of routines not defined here.

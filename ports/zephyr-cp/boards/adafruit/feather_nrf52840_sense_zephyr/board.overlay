/* Partition layout is owned by the mcuboot fork
 * (dts/adafruit/adafruit_feather_nrf52840.dtsi) and applied to this image by
 * sysbuild. This overlay only adds board/app config. */
/ {
	chosen {
		zephyr,console = &uart0;
		zephyr,shell-uart = &uart0;
		zephyr,uart-mcumgr = &uart0;
		zephyr,bt-mon-uart = &uart0;
		zephyr,bt-c2h-uart = &uart0;
	};
};

&zephyr_udc0 {
	/delete-node/ board_cdc_acm_uart;
};

&uart0 {
    status = "okay";
};

#include "../../../app.overlay"

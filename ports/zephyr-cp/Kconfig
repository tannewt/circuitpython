## ports/zephyr-cp/boards/frdm_mcxn947_mcxn947_cpu0.conf
```kconfig
CONFIG_DMA_TCD_QUEUE_SIZE=4

CONFIG_NETWORKING=y
CONFIG_NET_IPV4=y
CONFIG_NET_DHCPV4=y
CONFIG_NET_SOCKETS=y

CONFIG_NET_L2_ETHERNET=y
CONFIG_NET_MGMT_EVENT=y
CONFIG_NET_MGMT_EVENT_INFO=y

CONFIG_HEAP_MEM_POOL_SIZE=4096

CONFIG_MBEDTLS=y
CONFIG_MBEDTLS_BUILTIN=y
CONFIG_MBEDTLS_SHA1=y
CONFIG_MBEDTLS_USE_PSA_CRYPTO=n
```

## ports/zephyr-cp/boards/mcuboot_nucleo_u575zi_q.conf
```kconfig
# No retention device available.
CONFIG_MULTITHREADING=y
CONFIG_MCUBOOT_UF2_ENTRANCE_DOUBLE_TAP=n
```

## ports/zephyr-cp/boards/nrf7002dk_nrf5340_cpuapp.conf
```kconfig
CONFIG_NETWORKING=y
CONFIG_WIFI=y

CONFIG_MBEDTLS_SSL_PROTO_TLS1_2=y
CONFIG_MBEDTLS_USE_PSA_CRYPTO=n

CONFIG_BT_DEVICE_APPEARANCE_DYNAMIC=y
CONFIG_BT_DEVICE_NAME_DYNAMIC=y
CONFIG_BT_DEVICE_NAME_MAX=28

CONFIG_BT=y
CONFIG_BT_PERIPHERAL=y
CONFIG_BT_CENTRAL=y
CONFIG_BT_BROADCASTER=y
CONFIG_BT_OBSERVER=y
CONFIG_BT_EXT_ADV=y
CONFIG_BT_GATT_DYNAMIC_DB=y
CONFIG_BT_GATT_CLIENT=y

CONFIG_LOG=n
CONFIG_ASSERT=n
CONFIG_TEST_RANDOM_GENERATOR=y
```

## ports/zephyr-cp/dts/bindings/adafruit-itsybitsy-header.yaml
```yaml
# SPDX-FileCopyrightText: 2026 Dan Halbert for Adafruit Industries
# SPDX-License-Identifier: MIT

description: |
    GPIO pins exposed on the Adafruit ItsyBitsy nRF52840 headers.

    This binding provides a nexus mapping for 21 pins. The positions are in
    the order of the CONNECTORS["adafruit-itsybitsy-header"] names in
    cptools/zephyr2cp.py, not in physical header order:

         0 A0       7 MOSI    14 D5
         1 A1       8 MISO    15 D7
         2 A2       9 D0/RX   16 D9
         3 A3      10 D1/TX   17 D10
         4 A4      11 D2      18 D11
         5 A5      12 SDA     19 D12
         6 SCK     13 SCL     20 D13

    TODO: figure out how to handle the extra pins on other ItsyBitsy boards,
    such as D3 and D4 on the ItsyBitsy M4 and RP2040. We may want separate
    connectors for the different board families.

compatible: "adafruit-itsybitsy-header"

include: [gpio-nexus.yaml, base.yaml]
```

## ports/zephyr-cp/zephyr-config/west.yml
```yaml
manifest:
  group-filter:
    - +babblesim
  projects:
    - name: nrf_hw_models
      url: https://github.com/tannewt/ext_nRF_hw_models
      revision: 41cb69cd08848cc31e91ed62d01d397511981919
      path: modules/bsim_hw_models/nrf_hw_models
    - name: mcuboot
      url: https://github.com/adafruit/adaboot
      revision: b74a33125e2cfa4785af789763caa70fa12575a5
      path: bootloader/mcuboot
    - name: zephyr
      url: https://github.com/adafruit/zephyr
      revision: 499310df6e4da5ca54165c4b4c4c714771acb84c
      clone-depth: 100
      import: true
```

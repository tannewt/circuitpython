/* Remove slot1 (OTA), expand slot0 to use the space.
 * CircuitPython doesn't use OTA updates. */
&slot0_partition {
	/* Shrink mcuboot to 48KB, absorb slot1 + gap before storage */
	reg = <0x0000C000 0x000EC000>;
};

&boot_partition {
	reg = <0x00000000 0x0000C000>;
};

/delete-node/ &slot1_partition;

#include "../../../app.overlay"
